## variants/esp32-ball/sdkconfig.defaults.patch
```kconfig
--- toolchains/esp32/sdkconfig.defaults	2024-02-19 14:17:25.286885071 +0400
+++ toolchains/esp32-ball/sdkconfig.defaults	2024-02-24 20:17:51.599954914 +0400
@@ -38,6 +38,8 @@
 CONFIG_XTAL_FREQ_AUTO=y
 # CONFIG_ESP_PHY_CALIBRATION_AND_DATA_STORAGE is not set
 CONFIG_ESP_DEFAULT_CPU_FREQ_MHZ_240=y
+CONFIG_ESP_CONSOLE_UART_CUSTOM=y
+CONFIG_ESP_CONSOLE_UART_RX_GPIO=16
 # CONFIG_ESP_INT_WDT is not set
 # CONFIG_ESP_TASK_WDT_INIT is not set
 # CONFIG_ESP_DEBUG_OCDAWARE is not set
```
